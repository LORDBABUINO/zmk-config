## config/west.yml
```yaml
manifest:
  remotes:
    # this branch has mouse control configuration
    - name: urob
      url-base: https://github.com/urob
  projects:
    - name: zmk
      remote: urob
      revision: main
      import: app/west.yml
  self:
    path: config
```
